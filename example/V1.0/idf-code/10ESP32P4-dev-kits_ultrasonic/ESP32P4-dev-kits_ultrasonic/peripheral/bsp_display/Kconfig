## example/V1.0/idf-code/10ESP32P4-dev-kits_ultrasonic/ESP32P4-dev-kits_ultrasonic/peripheral/bsp_display/Kconfig
```kconfig
menu "BSP DISPLAY Setup"
    config BSP_DISPLAY_ENABLED
        bool "Enable display functions"
    
    if BSP_DISPLAY_ENABLED
        config H_SIZE
            int "Horizontal Resolution"
            default 1024

        config V_SIZE
            int "Vertical Resolution"
            default 600
      
        config BITS_PER_PIXEL
            int "Color depth"
            default 16

        config LCD_GPIO_RESET
            int "GPIO For LCD RESET"
            default 5

        config LCD_GPIO_BLIGHT
            int "GPIO For LCD BACKLIGHT"
            default 20

        config LCD_GPIO_UPDN
            int "GPIO For LCD UPDN"
            default 32

        config LCD_GPIO_SHLR
            int "GPIO For LCD SHLR"
            default 33

        config BLIGHT_PWM_Hz
            int "the PWM output HZ"
            default 30000

        config DISPLAY_LVGL_FULL_REFRESH
            bool "Enable fullscreen refresh"

        config DISPLAY_LVGL_DIRECT_MODE
            bool "Use screen-sized buffers"
        
        config DISPLAY_LVGL_AVOID_TEAR
            bool "Enable to avoid fragmentation"
    endif
    
endmenu
```

## example/V1.0/idf-code/11ESP32P4-dev-kits_dht20/ESP32P4-dev-kits_dht20/peripheral/bsp_dht20/Kconfig
```kconfig
menu "BSP DHT20 Setup"

    config BSP_DHT20_SENSOR_ENABLED
        bool "Enable DHT20 Temperature and Humidity sensor"
        depends on BSP_I2C_ENABLED

    if BSP_DHT20_SENSOR_ENABLED
        config DHT20_I2C_ADDRESS
            hex "DHT20 I2C Address"
            default 0x38
    endif
endmenu
```

## example/V1.0/idf-code/12ESP32P4-dev-kits_bh1750/ESP32P4-dev-kits_bh1750/peripheral/bsp_bh1750/Kconfig
```kconfig
menu "BSP BH1750 Setup"

    config BSP_BH1750_SENSOR_ENABLED
        bool "Enable BH1750 illumination sensor"
        depends on BSP_I2C_ENABLED

    if BSP_BH1750_SENSOR_ENABLED
        config BH1750_I2C_ADDRESS
            hex "BH1750 I2C Address"
            default 0x5C
    endif
endmenu
```

## example/V1.0/idf-code/13ESP32P4-dev-kits_lsm6ds3tr/ESP32P4-dev-kits_lsm6ds3tr/peripheral/bsp_lsm6ds3tr/Kconfig
```kconfig
menu "BSP LSM6DS3 Setup"
    config BSP_LSM6DS3_SENSOR_ENABLED
        bool "Enable LSM6DS3TR sensor"
        depends on BSP_I2C_ENABLED

    if BSP_LSM6DS3_SENSOR_ENABLED
        config LSM6DS3_I2C_ADDRESS
            hex "LSM6DS3TR I2C Address"
            default 0x6B
    endif
endmenu
```

## example/V1.0/idf-code/17ESP32P4-dev-kits_mic/ESP32P4-dev-kits_mic/peripheral/bsp_mic/Kconfig
```kconfig
menu "BSP MIC Setup"

    config BSP_MIC_ENABLED
        bool "Enable MIC"
        default n

    if BSP_MIC_ENABLED
        config MIC_GPIO_CLK
            int "GPIO For MIC CLK"
            default 3

        config MIC_GPIO_DATA
            int "GPIO For MIC DATA"
            default 4

        config MIC_SAMPLE_RATE
            int "PDM sample rate"
            default 16000
    endif
endmenu
```

## example/V1.0/idf-code/18ESP32P4-dev-kits_audio/ESP32P4-dev-kits_audio/peripheral/bsp_audio/Kconfig
```kconfig
menu "BSP AUDIO Setup"

    config BSP_AUDIO_ENABLED
        bool "Enable AUDIO"
        default n

    if BSP_AUDIO_ENABLED

        config AUDIO_GPIO_LRCLK
            int "GPIO For AUDIO LRCLK"
            default 21

        config AUDIO_GPIO_BCLK
            int "GPIO For AUDIO BCLK"
            default 22

        config AUDIO_GPIO_SDATA
            int "GPIO For AUDIO SDATA"
            default 23
        
        config AUDIO_GPIO_CTRL
            int "GPIO For AUDIO CTRL"
            default 6
    endif
endmenu
```

## example/V1.0/idf-code/18ESP32P4-dev-kits_audio/ESP32P4-dev-kits_audio/peripheral/bsp_sd/Kconfig
```kconfig
menu "BSP SD Setup"

    config BSP_SD_ENABLED
        bool "Enable SD CARD"
        default n

    if BSP_SD_ENABLED

        config FORMAT_IF_MOUNT_FAILED
            bool "Format the card if mount failed"
            default n
            help
                If this config item is set, format_if_mount_failed will be set to true and the card will be formatted if
                the mount has failed.

        config SD_GPIO_CLK
            int "SDIO CLK GPIO number"
            default 43

        config SD_GPIO_CMD
            int "SDIO CMD GPIO number"
            default 44 

        config SD_GPIO_D0
            int "SDIO D0 GPIO number"
            default 39

    endif

endmenu
```

## example/V1.0/idf-code/2ESP32P4-dev-kits_relay/ESP32P4-dev-kits_relay/peripheral/bsp_relay/Kconfig
```kconfig
menu "BSP RELAY Setup"

    config BSP_RELAY_ENABLED
        bool "Enable RELAY"
        default n

    if BSP_RELAY_ENABLED
        config RELAY_GPIO
            int "GPIO For RELAY"
            default 42
    endif
endmenu
```

## example/V1.0/idf-code/7ESP32P4-dev-kits_timer/ESP32P4-dev-kits_timer/peripheral/bsp_timer/Kconfig
```kconfig
menu "BSP Timer Setup"

    config BSP_TIMER_ENABLED
        bool "Enable Timer"
        default n

endmenu
```

## example/V1.0/idf-code/8ESP32P4-dev-kits_servo/ESP32P4-dev-kits_servo/peripheral/bsp_servo/Kconfig
```kconfig
menu "BSP SERVO Setup"
    config BSP_SERVO_ENABLED
        bool "Enable SERVO config"
        default n

    if BSP_SERVO_ENABLED
        config SERVO_GPIO
            int "GPIO For SERVO"
            default 25
    endif
endmenu
```

## example/V1.1/idf-code/10ESP32P4-dev-kits_ultrasonic/ESP32P4-dev-kits_ultrasonic/peripheral/bsp_ultrasonic/Kconfig
```kconfig
menu "BSP ULTRASONIC Setup"
    config BSP_ULTRASONIC_ENABLED
        bool "Enable ULTRASONIC config"
        default n

    if BSP_ULTRASONIC_ENABLED
        config ULTRASONIC_GPIO_ECHO
            int "GPIO For ULTRASONIC ECHO"
            default 12

        config ULTRASONIC_GPIO_TRIG
            int "GPIO For ULTRASONIC TRIG"
            default 13
    endif
endmenu
```

## example/V1.1/idf-code/14ESP32P4-dev-kits_led/ESP32P4-dev-kits_led/peripheral/bsp_led/Kconfig
```kconfig
menu "BSP LED Setup"
    config BSP_LED_ENABLED
        bool "Enable LED config"
        default n

    if BSP_LED_ENABLED
        config LED_GPIO
            int "GPIO For LED"
            default 8
    endif
endmenu
```

## example/V1.1/idf-code/15ESP32P4-dev-kits_key/ESP32P4-dev-kits_key/peripheral/bsp_key/Kconfig
```kconfig
menu "BSP KEY Setup"

    config BSP_KEY_ENABLED
        bool "Enable KEY"
        default n

    if BSP_KEY_ENABLED
        config KEY_GPIO
            int "GPIO For KEY"
            default 16
    endif
endmenu
```

## example/V1.1/idf-code/16ESP32P4-dev-kits_gas/ESP32P4-dev-kits_gas/peripheral/bsp_gas/Kconfig
```kconfig
menu "BSP GAS Setup"

    config BSP_GAS_ENABLED
        bool "Enable GAS"
        default n

    if BSP_GAS_ENABLED
        config GAS_CHANNEL
            int "ADC CHANNEL For GAS"
            default 1
    endif
endmenu
```

## example/V1.1/idf-code/3ESP32P4-dev-kits_touch/ESP32P4-dev-kits_touch/peripheral/bsp_touch/Kconfig
```kconfig
menu "BSP INDEPENDENT TOUCH Setup"

    config BSP_INDEPENDENT_TOUCH_ENABLED
        bool "Enable INDEPENDENT TOUCH"
        default n

    if BSP_INDEPENDENT_TOUCH_ENABLED
        config INDEPENDENT_TOUCH_GPIO
            int "GPIO For INDEPENDENT TOUCH"
            default 2
    endif
endmenu
```

## example/V1.1/idf-code/4ESP32P4-dev-kits_pir/ESP32P4-dev-kits_pir/peripheral/bsp_pir/Kconfig
```kconfig
menu "BSP PIR Setup"

    config BSP_PIR_ENABLED
        bool "Enable PIR config"
        default n

    if BSP_PIR_ENABLED
        config PIR_GPIO
            int "GPIO For PIR"
            default 24
    endif
endmenu
```

## example/V1.1/idf-code/5ESP32P4-dev-kits_hall/ESP32P4-dev-kits_hall/peripheral/bsp_hall/Kconfig
```kconfig
menu "BSP HALL Setup"

    config BSP_HALL_ENABLED
        bool "Enable HALL"
        default n

    if BSP_HALL_ENABLED
        config HALL_GPIO
            int "GPIO For HALL"
            default 7
    endif
endmenu
```

## example/V1.1/idf-code/6ESP32P4-dev-kits_uart/ESP32P4-dev-kits_uart/peripheral/bsp_led/Kconfig
```kconfig
menu "BSP LED Setup"

    config BSP_LED_ENABLED
        bool "Enable LED"
        default n

    if BSP_LED_ENABLED
        config LED_GPIO
            int "GPIO For LED"
            default 5
    endif
endmenu
```
